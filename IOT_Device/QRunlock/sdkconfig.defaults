## IOT_Device/Smart School Bell/ESP32-S3-RTC-PCM5102/firmware/sdkconfig.defaults
```kconfig
CONFIG_COMPILER_CXX_EXCEPTIONS=y
CONFIG_COMPILER_CXX_RTTI=y
CONFIG_ESP_MAIN_TASK_STACK_SIZE=24576
CONFIG_FREERTOS_HZ=1000
CONFIG_ESP_TASK_WDT_EN=y
CONFIG_ESP_TASK_WDT_TIMEOUT_S=10
CONFIG_ESPTOOLPY_FLASHSIZE_16MB=y
CONFIG_ESPTOOLPY_FLASHSIZE="16MB"
CONFIG_FATFS_LFN_HEAP=y
CONFIG_FATFS_MAX_LFN=255
CONFIG_FATFS_API_ENCODING_UTF_8=y
CONFIG_HTTPD_MAX_REQ_HDR_LEN=2048
CONFIG_HTTPD_MAX_URI_LEN=2048
CONFIG_HTTPD_WS_SUPPORT=y
CONFIG_MBEDTLS_CERTIFICATE_BUNDLE=y
CONFIG_MBEDTLS_CERTIFICATE_BUNDLE_DEFAULT_FULL=y
CONFIG_AUDIO_DECODER_MP3_SUPPORT=y
# CONFIG_AUDIO_DECODER_AAC_SUPPORT is not set
# CONFIG_AUDIO_DECODER_G711_SUPPORT is not set
# CONFIG_AUDIO_DECODER_AMRNB_SUPPORT is not set
# CONFIG_AUDIO_DECODER_AMRWB_SUPPORT is not set
# CONFIG_AUDIO_DECODER_FLAC_SUPPORT is not set
# CONFIG_AUDIO_DECODER_OPUS_SUPPORT is not set
# CONFIG_AUDIO_DECODER_VORBIS_SUPPORT is not set
# CONFIG_AUDIO_DECODER_ADPCM_SUPPORT is not set
# CONFIG_AUDIO_DECODER_ALAC_SUPPORT is not set
# CONFIG_AUDIO_DECODER_PCM_SUPPORT is not set
# CONFIG_AUDIO_DECODER_SBC_SUPPORT is not set
# CONFIG_AUDIO_DECODER_LC3_SUPPORT is not set
# CONFIG_AUDIO_DECODER_G722_SUPPORT is not set
# CONFIG_AUDIO_SIMPLE_DEC_WAV_SUPPORT is not set
# CONFIG_AUDIO_SIMPLE_DEC_M4A_SUPPORT is not set
# CONFIG_AUDIO_SIMPLE_DEC_TS_SUPPORT is not set
# CONFIG_AUDIO_SIMPLE_DEC_OGG_SUPPORT is not set
# CONFIG_AUDIO_ENCODER_AAC_SUPPORT is not set
# CONFIG_AUDIO_ENCODER_G711_SUPPORT is not set
# CONFIG_AUDIO_ENCODER_AMRNB_SUPPORT is not set
# CONFIG_AUDIO_ENCODER_AMRWB_SUPPORT is not set
# CONFIG_AUDIO_ENCODER_OPUS_SUPPORT is not set
# CONFIG_AUDIO_ENCODER_ADPCM_SUPPORT is not set
# CONFIG_AUDIO_ENCODER_ALAC_SUPPORT is not set
# CONFIG_AUDIO_ENCODER_PCM_SUPPORT is not set
# CONFIG_AUDIO_ENCODER_SBC_SUPPORT is not set
# CONFIG_AUDIO_ENCODER_LC3_SUPPORT is not set
# CONFIG_AUDIO_ENCODER_G722_SUPPORT is not set
```
